## Edurob_Firmware/main/Kconfig.projbuild
```kconfig
menu "EduRob"
    menu "Micro-ROS component"

        config MICRO_ROS_APP_STACK
            int "Stack the micro-ROS app (Bytes)"
            default 16000
            help
            Stack size in Bytes of the micro-ROS app

        config MICRO_ROS_APP_TASK_PRIO
            int "Priority of the micro-ROS app"
            default 5
            help
            Priority of micro-ros task higher value means higher priority

        config MICRO_ROS_DOMAIN_ID
            int "micro-ROS Domain ID"
            default 1
            help
                Domain ID used by micro-ROS.

    endmenu

    config TCPLASER_PORT
        int "Port for Access to UART"
        range 0 65535
        default 44227
        help
            Local port the TCP server will listen on.

endmenu
```

## Edurob_Firmware/sdkconfig.defaults
```kconfig
CONFIG_IDF_TARGET_ESP32S3=y
CONFIG_ESPTOOLPY_FLASHSIZE_16MB=y
CONFIG_ESPTOOLPY_FLASHSIZE="16MB"
CONFIG_ESPTOOLPY_HEADER_FLASHSIZE_UPDATE=y

# Partition Table
CONFIG_PARTITION_TABLE_CUSTOM=y
CONFIG_PARTITION_TABLE_CUSTOM_FILENAME="partitions.csv"
CONFIG_PARTITION_TABLE_OFFSET=0x8000
CONFIG_PARTITION_TABLE_MD5=y

# Compiler options
CONFIG_COMPILER_CXX_EXCEPTIONS=y

# HTTP Server
CONFIG_HTTPD_MAX_URI_LEN=1024

# Format
CONFIG_LOG_COLORS=y

# Free UART1 for RPLidar
# CONFIG_APPTRACE_DEST_UART0 is not set
# CONFIG_ESP_CONSOLE_UART_DEFAULT is not set
CONFIG_ESP_CONSOLE_USB_CDC=y
CONFIG_ESP_CONSOLE_UART_NUM=-1
CONFIG_ESP_CONSOLE_ROM_SERIAL_PORT_NUM=3
CONFIG_ESP_CONSOLE_USB_CDC_RX_BUF_SIZE=64
# CONFIG_ESP_CONSOLE_USB_CDC_SUPPORT_ETS_PRINTF is not set
# CONFIG_CONSOLE_UART_DEFAULT is not set
CONFIG_CONSOLE_UART_NUM=-1
```
